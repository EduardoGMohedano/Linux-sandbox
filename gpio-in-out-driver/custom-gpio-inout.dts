/dts-v1/;
/plugin/;

/ {
    compatible = "brcm,bcm2711";

    fragment@0 {
        target-path = "/";
        __overlay__ {
            custom_gpio_device {
                compatible = "custom,gpio-driver";
                status = "okay";
                gpios = <&gpio 17 0>,
                        <&gpio 23 0>;
            };
        };
    };

    fragment@1 {
        target = <&gpio>;
        __overlay__ {
            custom_gpio_pins: custom_gpio_pins {
                brcm,pins = <17 23>;
                brcm,function = <1 0>; /* Output  and input*/
                brcm,pull = <0 0>;     /* No pull resistor for both*/
            };
        };
    };
};